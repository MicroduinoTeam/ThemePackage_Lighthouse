/*
  =================================================================================
                             | 什么是台灯? |
  ---------------------------------------------------------------------------------

  按下碰撞开关彩暖灯，再按下开关彩灯关闭，重复循环。

  =================================================================================
                                   |开始|
  ---------------------------------------------------------------------------------
  利用碰撞开关控制彩灯！
  =================================================================================
                           |自己动手修改代码! |
  ---------------------------------------------------------------------------------

  BRIGHT_MAX: LED彩灯显示的最大亮度。
  更改开灯的颜色。

  修改完这些值后，记得再把代码上传到核心才能有反应。
  =================================================================================
                              | 头脑风暴|
  ---------------------------------------------------------------------------------
  1. 除了碰撞开关，还能用什么来控制氛围灯？
     红外接收传感器? 光照传感器? 声音传感器?
  2. 可以把LED灯贴在电机上，把它改装成酷炫的灯光秀吗？
     当然可以，也许你可以做出一个迪斯科球!
  3. 可以用纸板来设计一个独特的氛围灯吗?
     你可以在纸板上戳几个洞，做一个星光灯。

    注意: 以上功能上的变动会涉及到程序上的改动。
  =================================================================================
                               | 端口连接|
  ---------------------------------------------------------------------------------
  碰撞开关: D6
  彩灯：    D4
  =================================================================================
                                  | 问题 |
  ---------------------------------------------------------------------------------
  欢迎访问 http://forum.microduino.cn/，在我们的论坛提交您的问题， 我们会尽快回复您。
*/

#include <Microduino_Key.h>
#include <Microduino_ColorLED.h> //引用彩灯库

#define KEYPIN      6     //碰撞开关引脚
#define PIN_LED     4     //彩灯引脚
#define LED_NUM     2      //彩灯的数量
#define BRIGHT_MAX  200    //LED彩灯显示的最大亮度。最大亮度是255，最小亮度是0

DigitalKey keyA(KEYPIN);
ColorLED strip = ColorLED(LED_NUM, PIN_LED); //将ColorLED类命名为strip，并定义彩灯数量和彩灯引脚号

/***********定义彩灯颜色*/
const uint32_t colorArray[10] = {
  COLOR_NONE,       //0x000000, 彩灯关闭，colorLED OFF
  COLOR_RED,        //0xff0000, 红色，Red
  COLOR_ORANGE,     //0xea8b17, 橙色，Orange
  COLOR_YELLOW,     //0xffff00, 黄色，Yellow
  COLOR_GREEN,      //0x00ff00, 绿色，Green
  COLOR_CYAN,       //0x00ffff, 青色，Cyan
  COLOR_BLUE,       //0x0000ff, 蓝色，Blue
  COLOR_PURPLE,     //0xff00ff, 紫色，Purple
  COLOR_WARM,       //0x9b6400, 暖色，Warm
  COLOR_COLD,       //0x648264, 冷色，Cold
};

boolean ledon;

void setup() {
  Serial.begin(57600);
  strip.begin();
  strip.setBrightness(BRIGHT_MAX);
  keyA.begin(INPUT);
  //每隔0.1秒换一种颜色，总共十种颜色。
  for (int i = 0; i < 10; i++)
  {
    strip.setAllLED(colorArray[i]);
    strip.show();
    delay(150);   //每个颜色持续时间
  }
}

void loop() {
  //按下碰撞开关，切换ledon的值，等价于切换开启（true）、关闭（false）
  if (keyA.readEvent() == SHORT_PRESS) {
    ledon = !ledon;
  }

  //根据碰撞开关选的值，控制彩灯
  if (ledon) {
    strip.setAllLED(colorArray[8]);
    strip.show();
  }
  else {
    strip.setAllLED(colorArray[0]);
    strip.show();
  }

  delay(15);
}
